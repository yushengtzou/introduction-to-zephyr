## scripts/rp2/west.yml
```yaml
manifest:
  defaults:
    remote: upstream

  remotes:
    - name: upstream
      url-base: https://github.com/zephyrproject-rtos

  group-filter: [-optional]

  #
  # Please add items below based on alphabetical order
  projects:
    - name: acpica
      revision: 8d24867bc9c9d81c81eeac59391cda59333affd4
      path: modules/lib/acpica
    - name: cmsis
      revision: 4b96cbb174678dcd3ca86e11e1f24bc5f8726da0
      path: modules/hal/cmsis
      groups:
        - hal
    - name: cmsis-dsp
      revision: 6489e771e9c405f1763b52d64a3f17a1ec488ace
      path: modules/lib/cmsis-dsp
    - name: cmsis-nn
      revision: ea987c1ca661be723de83bd159aed815d6cbd430
      path: modules/lib/cmsis-nn
    - name: edtt
      revision: b9ca3c7030518f07b7937dacf970d37a47865a76
      path: tools/edtt
      groups:
        - tools
    - name: fatfs
      revision: 427159bf95ea49b7680facffaa29ad506b42709b
      path: modules/fs/fatfs
      groups:
        - fs
    - name: hal_infineon
      revision: 88d2529a3c5aee2e81947553bf6cbacb4671088c
      path: modules/hal/infineon
      groups:
        - hal
    - name: hal_rpi_pico
      revision: 79ee0f9e058a6327fc943d2f2a19cf3ade107cec
      path: modules/hal/rpi_pico
      groups:
        - hal
    - name: hostap
      path: modules/lib/hostap
      revision: c533ab18dcf71795dcee61f4d2598ae31098f731
    - name: liblc3
      revision: 1a5938ebaca4f13fe79ce074f5dee079783aa29f
      path: modules/lib/liblc3
    - name: littlefs
      path: modules/fs/littlefs
      groups:
        - fs
      revision: 009bcff0ed4853a53df8256039fa815bda6854dd
    - name: loramac-node
      revision: fb00b383072518c918e2258b0916c996f2d4eebe
      path: modules/lib/loramac-node
    - name: lvgl
      revision: 2b498e6f36d6b82ae1da12c8b7742e318624ecf5
      path: modules/lib/gui/lvgl
    - name: mbedtls
      revision: a78176c6ff0733ba08018cba4447bd3f20de7978
      path: modules/crypto/mbedtls
      groups:
        - crypto
    - name: mcuboot
      revision: 33de65cebaf78b306501a4195dc0ce4008315e1a
      path: bootloader/mcuboot
      groups:
        - bootloader
    - name: mipi-sys-t
      path: modules/debug/mipi-sys-t
      groups:
        - debug
      revision: 71ace1f5caa03e56c8740a09863e685efb4b2360
    - name: net-tools
      revision: 93acc8bac4661e74e695eb1aea94c7c5262db2e2
      path: tools/net-tools
      groups:
        - tools
    - name: openthread
      revision: 2aeb8b833ba760ec29d5f340dd1ce7bcb61c5d56
      path: modules/lib/openthread
    - name: percepio
      path: modules/debug/percepio
      revision: b68d17993109b9bee6b45dc8c9794e7b7bce236d
      groups:
        - debug
    - name: picolibc
      path: modules/lib/picolibc
      revision: d492d5fa7c96918e37653f303028346bb0dd51a2
    - name: segger
      revision: b011c45b585e097d95d9cf93edf4f2e01588d3cd
      path: modules/debug/segger
      groups:
        - debug
    - name: tinycrypt
      revision: 1012a3ebee18c15ede5efc8332ee2fc37817670f
      path: modules/crypto/tinycrypt
      groups:
        - crypto
    - name: trusted-firmware-m
      revision: a11cd27905aecc4416cfc85552bfc3b997375056
      path: modules/tee/tf-m/trusted-firmware-m
      groups:
        - tee
    - name: trusted-firmware-a
      revision: 713ffbf96c5bcbdeab757423f10f73eb304eff07
      path: modules/tee/tf-a/trusted-firmware-a
      groups:
        - tee
    - name: uoscore-uedhoc
      revision: 84ef879a46d7bfd9a423fbfb502b04289861f9ea
      path: modules/lib/uoscore-uedhoc
    - name: zcbor
      revision: 47f34dd7f5284e8750b5a715dee7f77c6c5bdc3f
      path: modules/lib/zcbor

  self:
    path: zephyr
    west-commands: scripts/west-commands.yml
    import: submanifests
```

## workspace/apps/wifi_apsta_mode/boards/esp32_devkitc_wroom_procpu.conf
```kconfig
CONFIG_WIFI_ESP32=y
CONFIG_ESP32_WIFI_STA_AUTO_DHCPV4=y
CONFIG_ESP32_WIFI_AP_STA_MODE=y
CONFIG_WIFI_NM=y
CONFIG_WIFI_NM_MAX_MANAGED_INTERFACES=2

CONFIG_ESP_WIFI_HEAP_RUNTIME=n
CONFIG_ESP_WIFI_HEAP_SYSTEM=y
CONFIG_HEAP_MEM_POOL_SIZE=51200
CONFIG_MAIN_STACK_SIZE=4096

# Enable core dump logging
CONFIG_LOG=y
CONFIG_LOG_DEFAULT_LEVEL=4
CONFIG_DEBUG_COREDUMP=y
CONFIG_DEBUG_COREDUMP_BACKEND_LOGGING=y
CONFIG_DEBUG_COREDUMP_MEMORY_DUMP_LINKER_RAM=y
```

## workspace/boards/custom/nyan/Kconfig
```kconfig
config HEAP_MEM_POOL_ADD_SIZE_BOARD
	int
	default 4096 if BOARD_NYAN_ESP32S3_PROCPU
	default 256 if BOARD_NYAN_ESP32S3_APPCPU
```

## workspace/boards/custom/nyan/Kconfig.nyan
```kconfig
config BOARD_NYAN
	select SOC_ESP32S3_WROOM_N8
	select SOC_ESP32S3_PROCPU if BOARD_NYAN_ESP32S3_PROCPU
	select SOC_ESP32S3_APPCPU if BOARD_NYAN_ESP32S3_APPCPU
```

## workspace/boards/custom/nyan/board.yml
```yaml
board:
  name: nyan
  full_name: Nyan
  vendor: espressif
  socs:
  - name: esp32s3
```
